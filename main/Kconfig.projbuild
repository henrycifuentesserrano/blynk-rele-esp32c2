## main/Kconfig.projbuild
```kconfig
menu "Blynk Rele Configuration"

    config WIFI_SSID
        string "WiFi SSID"
        default "myssid"
        help
            Nombre de la red WiFi (solo para desarrollo, en campo usar provisioning).

    config WIFI_PASSWORD
        string "WiFi Password"
        default "mypassword"
        help
            Contrasena de la red WiFi.

    config DEVICE_LATITUDE
        string "Latitud del dispositivo"
        default "4.1234"
        help
            Latitud GPS del dispositivo instalado.

    config DEVICE_LONGITUDE
        string "Longitud del dispositivo"
        default "-74.1234"
        help
            Longitud GPS del dispositivo instalado.

    config AP_SSID
        string "Nombre del Access Point de configuracion"
        default "Alarma-Config"
        help
            Nombre de la red WiFi que crea el ESP32 en modo provisioning.

    config AP_PASSWORD
        string "Contrasena del Access Point"
        default "alarma123"
        help
            Contrasena de la red WiFi de configuracion.

endmenu
```
